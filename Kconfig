## boards/Kconfig
```kconfig
# Kconfig - Config options for board
#
# Copyright (c) 2021 Intel Corporation
#
# SPDX-License-Identifier: Apache-2.0
#

menu "Optional board features"

config DEPRECATED_HW_STRAP_BASED_PECI_MODE_SEL
	bool "Enable HW Strap reading to determine peci mode only for ADL-S"
	help
	  Indicate if EC supporting HW strap reading or BIOS menu option.
	  Remove this in future platforms and have only BIOS Menu option.

config BOARD_ID_IO_EXPANDER
	bool "IO Expander used for generating board ID"
	default y
	help
	  Indicates if board ID is generated making use of an IO Expander.

config ATX_SUPPORT
	bool "ATX power supply detection"
	help
	  Indicate if EC handles detection of ATX power supply.

choice
	prompt "Select Intel RVP when using EC modular card"
	default MEC15XX_AIC_ON_ADL_S if BOARD_MEC1501MODULAR_ASSY6885
	default MEC172X_AIC_ON_MTL_P if BOARD_MEC172XMODULAR_ASSY6930
	help
	  Select Intel RVP and modular card combination to be used.
	  This is required since some peripherals an MECC connector pin
	  mappings vary slightly from board to board.

	config MEC15XX_AIC_ON_ADL_S
		depends on BOARD_MEC1501MODULAR_ASSY6885
		bool "Allow to use ADL-S with MECC card"

	config MEC15XX_AIC_ON_TGL
		depends on BOARD_MEC1501MODULAR_ASSY6885
		bool "Use TGL RVP with MECC card"

	config MEC15XX_AIC_ON_ICL
		depends on BOARD_MEC1501MODULAR_ASSY6885
		bool "Allow to use ICL with MECC card"

	config MEC172X_AIC_ON_MTL_P
		depends on BOARD_MEC172XMODULAR_ASSY6930
		bool "Allow to use MTL-P with MECC172x card"

	config MEC172X_AIC_ON_ADL_P
		depends on BOARD_MEC172XMODULAR_ASSY6930
		bool "Use ADL-P with MEC17xx card"

	config MEC172X_AIC_ON_ADL_S
		depends on BOARD_MEC172XMODULAR_ASSY6930
		bool "Allow to use ADL-S with MECC172x card"

endchoice

config MEC172X_AIC_HW_REV2
	bool "Use MEC172x HW revision 2"
	depends on BOARD_MEC172XMODULAR_ASSY6930
	help
	  Use MEC172x HW rev 2 gpio configuration

endmenu
```

## boards/mec1501_adl.conf
```kconfig
# Zephyr-based EC FW

# EC FW features configuration
# ----------------------------
CONFIG_ATX_SUPPORT=y
# Disable PECI access in CS for desktop platforms.
CONFIG_PECI_ACCESS_DISABLE_IN_CS=y

#Enable hw strap reading to determine the peci mode as
#BIOS team not provided the BIOS option on ADL-S
CONFIG_DEPRECATED_HW_STRAP_BASED_PECI_MODE_SEL=y

# Support deprecated SMChost commands for backward compatibility
CONFIG_DEPRECATED_SMCHOST_CMD=y

# Soc-specific configuration
# --------------------------
# Main clock is derived from external crystal
CONFIG_SOC_MEC1501_EXT_32K=y
CONFIG_SOC_MEC1501_EXT_32K_CRYSTAL=y
CONFIG_SOC_MEC1501_EXT_32K_PARALLEL_CRYSTAL=y
CONFIG_SOC_MEC1501_VCI_PINS_AS_GPIOS=y
```

## boards/mec1501_adl_p.conf
```kconfig
# Zephyr-based EC FW

# EC FW features configuration
# ----------------------------
CONFIG_PWRMGMT_DEEPSX=y

# EC FW keyscan configuration
CONFIG_KSCAN_EC=y

CONFIG_SOC_DEBUG_CONSENT_GPIO=y

# Support deprecated SMChost commands for backward compatibility
CONFIG_DEPRECATED_SMCHOST_CMD=y

# Zephyr kernel/driver configuration required by EC FW
# ----------------------------------------------------
# Enable additional drivers for ADL-P
CONFIG_PS2=y

# IO expander support interrupt
CONFIG_GPIO_PCA95XX_INTERRUPT=y

# Soc-specific configuration
# --------------------------
CONFIG_SOC_MEC1501_VCI_PINS_AS_GPIOS=y
```

## boards/mec1501_adl_p_prodrive.conf
```kconfig
# Zephyr-based EC FW

# EC FW features configuration
# ----------------------------

CONFIG_PWRMGMT_DEEPSX=n

# Enable SMCHOST required for EC LPM
CONFIG_SMCHOST_EVENT_DRIVEN_TASK=y

# EC FW keyscan configuration
CONFIG_KSCAN=n
CONFIG_KSCAN_EC=n
CONFIG_KSCAN_XEC=n
CONFIG_ESPI_PERIPHERAL_8042_KBC=n
CONFIG_PS2_KEYBOARD_AND_MOUSE=n

CONFIG_POSTCODE_MANAGEMENT=n
CONFIG_ESPI_PERIPHERAL_DEBUG_PORT_80=n

CONFIG_SOC_DEBUG_CONSENT_GPIO=y

# Support deprecated SMChost commands for backward compatibility
CONFIG_DEPRECATED_SMCHOST_CMD=y

# Zephyr kernel/driver configuration required by EC FW
# ----------------------------------------------------
# Enable additional drivers for ADL-P
CONFIG_PS2=n
CONFIG_ADC=n
CONFIG_ADC_XEC=n

# IO expander support
CONFIG_BOARD_ID_IO_EXPANDER=n
CONFIG_GPIO_PCA95XX=n
CONFIG_GPIO_PCA95XX_INTERRUPT=n

CONFIG_DNX_SUPPORT=n
CONFIG_LOG_OVERRIDE_LEVEL=2
CONFIG_EC_LOG_LEVEL=2
CONFIG_PERIPHERAL_LOG_LEVEL=4
CONFIG_BOARD_LOG_LEVEL=2
CONFIG_PWRMGT_LOG_LEVEL=4
```

## boards/mec1501_mtl_p.conf
```kconfig
# Zephyr-based EC FW

# EC FW keyscan configuration
CONFIG_KSCAN_EC=y

CONFIG_SOC_DEBUG_CONSENT_GPIO=y

# Support deprecated SMChost commands for backward compatibility
CONFIG_DEPRECATED_SMCHOST_CMD=y

# Gigadevice
CONFIG_SAF_ENABLE_XIP=y

# Zephyr kernel/driver configuration required by EC FW
# ----------------------------------------------------

CONFIG_PS2=y

# IO expander support interrupt
CONFIG_GPIO_PCA95XX_INTERRUPT=y

# Soc-specific configuration
# --------------------------
CONFIG_SOC_MEC1501_VCI_PINS_AS_GPIOS=y
```

## boards/mec1501modular_assy6885.conf
```kconfig
# Zephyr-based EC FW

# EC FW features configuration
# ----------------------------
# Minimum eSPI capabilities in reference board
CONFIG_POWER_SEQUENCE_MINIMUM_ESPI_CAPS=y

# Disable DeepSx for reference board
CONFIG_PWRMGMT_DEEPSX=n

# Thermal management partially supported on TGL + MECC
# Reworks are required for PECI legacy and FAN
# Use fan always on connection if these are not performed
CONFIG_THERMAL_FAN_OVERRIDE=y

# EC keyscan configuration
CONFIG_KSCAN_EC=y

# Board keyboard override
CONFIG_EC_FUJITSU_KEYBOARD=y

# Enable boot keysequence timeout
CONFIG_EARLY_KEY_SEQUENCE_DETECTION=y
CONFIG_POWER_SEQUENCE_DISABLE_TIMEOUT_HOTKEY=y

# Support deprecated SMChost commands for backward compatibility
CONFIG_DEPRECATED_SMCHOST_CMD=y

# Zephyr kernel/driver configuration required by EC FW
# ----------------------------------------------------
CONFIG_SAF_SPI_CAPACITY=16

# Enable PECI driver for thermal
CONFIG_PECI=y
CONFIG_KSCAN=y
CONFIG_KSCAN_XEC_DEBOUNCE_UP=1
CONFIG_KSCAN_XEC_DEBOUNCE_DOWN=1

# Below features need to be explicitly enabled since by default all public
# boards only enable GPIO/PINCTRL drivers.
CONFIG_I2C=y
CONFIG_ADC=y
CONFIG_PWM=y
CONFIG_SENSOR=y
CONFIG_TACH_XEC=y
CONFIG_ESPI=y
```

## boards/mec172x_mtl_s.conf
```kconfig
# Zephyr-based EC FW

# EC FW features configuration
# ----------------------------
CONFIG_ATX_SUPPORT=y

CONFIG_PWRMGMT_DEEPSX=y

# Enable PS2 device management but only keyboard due SoC port limitation
CONFIG_PS2=y
CONFIG_PS2_KEYBOARD=y
CONFIG_PS2_MOUSE=n

#Use UART0 for the eSPI communication
#-------------------------------------
CONFIG_ESPI_PERIPHERAL_UART_SOC_MAPPING=0

# Disable PECI access in CS for desktop platforms.
CONFIG_PECI_ACCESS_DISABLE_IN_CS=y

# Support deprecated SMChost commands for backward compatibility
CONFIG_DEPRECATED_SMCHOST_CMD=y

# Enable gigadevice sequence
CONFIG_SAF_ENABLE_XIP=y

# Zephyr kernel/driver configuration required by EC FW
# ----------------------------------------------------
CONFIG_ESPI_PERIPHERAL_8042_KBC=y

# Workaround to avoid overlap in SPI layout
CONFIG_FLASH_SIZE=224

# Enable SAF
CONFIG_ESPI_SAF=y
CONFIG_DEBUG_INFO=y
CONFIG_STACK_USAGE=y
# SW stack sentinel cannot coexist with USER_SPACE
CONFIG_STACK_SENTINEL=n
CONFIG_ARM_MPU=y
CONFIG_USERSPACE=y
CONFIG_MAX_THREAD_BYTES=2
```

## boards/mec172x_ptl_uh.conf
```kconfig
# Zephyr-based EC FW

# EC FW features configuration
# ----------------------------

# Enable PS2 device management but only keyboard due SoC port limitation
CONFIG_PS2_KEYBOARD=y
CONFIG_PS2_MOUSE=n

# EC FW keyscan configuration
CONFIG_KSCAN_EC=y
CONFIG_SOC_DEBUG_CONSENT_GPIO=y

#Use UART0 for the eSPI communication
#-------------------------------------
CONFIG_ESPI_PERIPHERAL_UART_SOC_MAPPING=0

# Support deprecated SMChost commands for backward compatibility
CONFIG_DEPRECATED_SMCHOST_CMD=y

# Enable gigadevice sequence
CONFIG_SAF_ENABLE_XIP=y
CONFIG_SPI_VENDOR_MACRONIX=y

# Zephyr kernel/driver configuration required by EC FW
# ----------------------------------------------------
CONFIG_PS2=y
CONFIG_ESPI_PERIPHERAL_8042_KBC=y

# IO expander support interrupt
CONFIG_GPIO_PCA95XX_INTERRUPT=y

# Workaround to avoid overlap in SPI layout
CONFIG_FLASH_SIZE=224

# Enable SAF
CONFIG_ESPI_SAF=y
CONFIG_SAF_SPI_CAPACITY=64
```

## boards/mec172xlj_mtl_template.conf
```kconfig
# Zephyr-based EC FW

# EC FW features configuration
# ----------------------------
CONFIG_ATX_SUPPORT=y

CONFIG_PWRMGMT_DEEPSX=y

# Enable PS2 device management but only keyboard due SoC port limitation
CONFIG_PS2=y
CONFIG_PS2_KEYBOARD=y
CONFIG_PS2_MOUSE=n

#Use UART0 for the eSPI communication
#-------------------------------------
CONFIG_ESPI_PERIPHERAL_UART_SOC_MAPPING=0

# Disable PECI access in CS for desktop platforms.
CONFIG_PECI_ACCESS_DISABLE_IN_CS=y

# Support deprecated SMChost commands for backward compatibility
CONFIG_DEPRECATED_SMCHOST_CMD=y

# Host needs to access 64MB SPI flash device
CONFIG_SAF_SPI_CAPACITY=64

# Zephyr kernel/driver configuration required by EC FW
# ----------------------------------------------------
CONFIG_ESPI_PERIPHERAL_8042_KBC=y

# Adjust as needed. MEC1723 has by default 354 KB for code
# Template is based on MTL-S where EC region is only 512 KB
# So this is a workaround to fit primary and backup images into said region
CONFIG_FLASH_SIZE=224

# Enable SAF
CONFIG_ESPI_SAF=y
```

## boards/mec172xmodular_assy6930.conf
```kconfig
# Zephyr-based EC FW

# EC FW features configuration
# ----------------------------
# Minimum eSPI capabilities in reference board
CONFIG_POWER_SEQUENCE_MINIMUM_ESPI_CAPS=y

CONFIG_PECI_OVER_ESPI_ENABLE=y

# EC keyscan configuration
CONFIG_KSCAN_EC=y

# Enable PS2 device management but only keyboard due SoC port limitation
CONFIG_PS2_KEYBOARD=y
CONFIG_PS2_MOUSE=n

# Board keyboard override
CONFIG_EC_FUJITSU_KEYBOARD=y

# Enable boot keysequence timeout
CONFIG_EARLY_KEY_SEQUENCE_DETECTION=y
CONFIG_POWER_SEQUENCE_DISABLE_TIMEOUT_HOTKEY=y

# Support deprecated SMChost commands for backward compatibility
CONFIG_DEPRECATED_SMCHOST_CMD=y

# Gigadevice
CONFIG_SAF_ENABLE_XIP=y

# Enable REV2 flag as RVP team using the REV2 cards
CONFIG_MEC172X_AIC_HW_REV2=y

# Zephyr kernel/driver configuration required by EC FW
# ----------------------------------------------------
CONFIG_ESPI_PERIPHERAL_8042_KBC=y

# Enable non-bot critical drivers not enabled by default on mec172x modular
CONFIG_PS2=y
CONFIG_PWM=y
CONFIG_SENSOR=y
CONFIG_PECI=y
CONFIG_KSCAN=y
CONFIG_KSCAN_XEC_DEBOUNCE_UP=1
CONFIG_KSCAN_XEC_DEBOUNCE_DOWN=1
```

## boards/npcx4m8f_ptl.conf
```kconfig
# EC FW features configuration
# ----------------------------
# Battery support
CONFIG_BATTERY_MANAGEMENT=y

# USBC configs
CONFIG_USBC_POWER_DELIVERY=y
CONFIG_TI_USBC_PD_CONTROLLER=y
CONFIG_CYPRESS_USBC_SINGLE_PORT_PD_CONTROLLER=y
CONFIG_REALTEK_USBC_PD_CONTROLLER=y
CONFIG_USBC_MAILBOX_COMMAND_SUPPORT=y
CONFIG_USBC_SRC_POLICY=y
CONFIG_USBC_SINK_POLICY=y
CONFIG_ADP_SINK_PATH_EN=y
CONFIG_USBC_TOMCAT_SUPPORT=y
#CONFIG_USBC_IO_MODULE_POLICY=y
CONFIG_USBC_UCSI_2_1=y

# Disable DeepSx for reference board
CONFIG_PWRMGMT_DEEPSX=n

# EC keyscan configuration
CONFIG_KSCAN_EC=n

# PS2 device management
CONFIG_PS2_KEYBOARD=y
CONFIG_PS2_MOUSE=n

# Support deprecated SMChost commands for backward compatibility
CONFIG_DEPRECATED_SMCHOST_CMD=y

# EC FW LPM
CONFIG_PWRMGMT_DEEP_IDLE=y

CONFIG_FIRMWARE_RECOVERY=y
CONFIG_NVME_RECOVERY=y

# Zephyr kernel/driver configuration required by EC FW
# ----------------------------------------------------
# Enable non-boot critical drivers not enabled by default on npcx4
CONFIG_I2C=y
CONFIG_PWM=y
CONFIG_SENSOR=y
CONFIG_ADC=y
CONFIG_PECI=y
CONFIG_GPIO_PCA95XX=y
CONFIG_GPIO_PCA95XX_INTERRUPT=y

CONFIG_ESPI=y
CONFIG_ESPI_OOB_CHANNEL_RX_ASYNC=y
CONFIG_ESPI_NPCX_PERIPHERAL_DEBUG_PORT_80_MULTI_BYTE=y
CONFIG_ESPI_PERIPHERAL_UART=y
CONFIG_ESPI_PERIPHERAL_8042_KBC=n
CONFIG_ESPI_FLASH_CHANNEL=y
CONFIG_ESPI_PERIPHERAL_HOST_IO_PVT=y
# New SoC eSPI behaviour
CONFIG_ESPI_VWIRE_VALID_BIT_CHECK=n

CONFIG_ESPI_SAF=y
CONFIG_FLASH=y
CONFIG_ESPI_TAF_PR_NUM=16
CONFIG_ESPI_TAF_AUTO_MODE=y

CONFIG_I3C=y
CONFIG_PS2=y
CONFIG_KSCAN=n
CONFIG_SPI=n
CONFIG_FLASH_SIZE=224

CONFIG_PM=n
```

## drivers/Kconfig
```kconfig
# Kconfig - Config options for EC FW drivers
#
# Copyright (c) 2021 Intel Corporation
#
# SPDX-License-Identifier: Apache-2.0
#

menu "Keyboard matrix driver"

if KSCAN_EC || PS2_KEYBOARD
choice
	prompt "Select your keyboard"
	default EC_GTECH_KEYBOARD
	help
	 Select your keyboard implementation which is going
	 to allow you to handle variations specially in
	 alternate functions.

	config EC_GTECH_KEYBOARD
	bool "Gtech keyboard"

	config EC_FUJITSU_KEYBOARD
	bool "Fujitsu keyboard"

endchoice

config EARLY_KEY_SEQUENCE_DETECTION
	bool "Turn on kscan early key sequence detection"
	depends on KSCAN_EC
	help
	 Request that the keyboard scan matrix driver detects key sequence and
	 notifies to an propagate these to other EC modules in addition to kbchost

config EARLY_KEYSEQ_CUSTOM0
	int "Custom key trigger to detect"
	# Letter d
	default 33
	depends on EARLY_KEY_SEQUENCE_DETECTION
	help
	  Intercept this key sequence at boot to perform any user defined
	  operation.

config EARLY_KEYSEQ_CUSTOM1
	int "Custom key trigger to detect"
	# Letter e
	default 19
	depends on EARLY_KEY_SEQUENCE_DETECTION
	help
	  Intercept this key sequence at boot to perform any user defined
	  operation.

endif

endmenu

menu "eSPI hub features"
config OOBMNGR_SUPPORT
	bool "Enable OOB manager support"
	default n
	help
	  Enable EC support for OOB manager eSPI hub extension to tunnel all
	  the OOB traffic through OOB manager APIs.

config ENABLE_ESPI_LTR
	bool "Enable Latency Tolerance Reporting"
	help
	  Sends LTR message once BME is enabled.

endmenu

choice
	prompt "Select the vendor of the SPI Flash"
	default SPI_VENDOR_WINBOND
	help
	  Select the vendor for the SPI Flash on the
	  board. The SPI access functions may have differences
	  based on the vendor selected.

	config SPI_VENDOR_WINBOND
	bool "WINBOND SPI Flash"

	config SPI_VENDOR_GIGADEVICE
	bool "GIGADEVICE SPI FLASH"

endchoice

menu "EC basic drivers logging control"

config MAX6958_LOG_LEVEL
	int "MAX6958 driver log level"
	depends on LOG
	default 2 if EC_DEBUG_LOG
	default 0
	help
	  Set log level for MAX5958 LED driver.

config EEPROM_LOG_LEVEL
	int "EEPROM driver log level"
	depends on LOG
	default 2 if EC_DEBUG_LOG
	default 0
	help
	  Set log level for EEPROM driver.

config GPIO_EC_LOG_LEVEL
	int "GPIO EC driver log level"
	depends on LOG
	default 2 if EC_DEBUG_LOG
	default 0
	help
	  Set log level for GPIO wrapper driver.

config ESPIHUB_LOG_LEVEL
	int "eSPI hub driver log level"
	depends on LOG
	default 2 if EC_DEBUG_LOG
	default 0
	help
	  Set log level for eSPI hub.

config ESPIOOB_MNGR_LOG_LEVEL
	int "eSPI OOB manager driver log level"
	depends on LOG
	default 2 if EC_DEBUG_LOG
	default 0
	help
	  Set log level for eSPI OOB manager.

config PECIHUB_LOG_LEVEL
	int "peci hub log level"
	depends on LOG
	default 2 if EC_DEBUG_LOG
	default 0
	help
	  Set log level for peci hub interface.

config FAN_LOG_LEVEL
	int "Fan driver log level"
	depends on LOG
	default 2 if EC_DEBUG_LOG
	default 0
	help
	  Set log level for fan driver.

config LED_LOG_LEVEL
	int "Led driver log level"
	depends on LOG
	default 2 if EC_DEBUG_LOG
	default 0
	help
	  Set log level for led driver.

config I2C_HUB_LOG_LEVEL
	int "I2C hub driver log level"
	depends on LOG
	default 2 if EC_DEBUG_LOG
	default 0
	help
	  Set log level for i2c hub driver.

endmenu

menu "EC optional drivers logging control"

config ADC_SENSORS_LOG_LEVEL
	int "ADC thermal sensor driver log level"
	depends on LOG
	default 2 if EC_DEBUG_LOG
	default 0
	help
	  Set log level for thermal sensor driver.

endmenu
```
