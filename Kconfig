## Kconfig
```kconfig
# Kconfig - Config options for EC FW

#
# Copyright (c) 2019 Intel Corporation
#
# SPDX-License-Identifier: Apache-2.0
#

mainmenu "Embedded controller firmware application"

rsource "app/peripheral_management/Kconfig"
rsource "app/debug/Kconfig"
rsource "app/power_sequencing/Kconfig"
rsource "app/saf/Kconfig"
rsource "app/smchost/Kconfig"
rsource "app/kbchost/Kconfig"
rsource "app/thermal_management/Kconfig"

menu "EC optional features"

rsource "app/power_management/Kconfig"
rsource "app/dnx/Kconfig"
rsource "app/soc_debug_awareness/Kconfig"
rsource "boards/Kconfig"

endmenu

menu "EC logging control"

config EC_DEBUG_LOG
	bool "Embedded controller logs"
	depends on LOG
	default y
	help
	  Enable minimum log level for all modules.

config EC_LOG_LEVEL
	int "Embedded controller application log level"
	depends on LOG
	default 2 if EC_DEBUG_LOG
	default 0
	help
	  Set log level for EC FW app modules.

config BOARD_LOG_LEVEL
	int "Board initialization log level"
	depends on LOG
	default 2 if EC_DEBUG_LOG
	default 0
	help
	  Set log level for board initialization module.

endmenu

rsource "drivers/Kconfig"

source "Kconfig.zephyr"
```

## app/debug/Kconfig
```kconfig
# Kconfig - Config options for EC FW debug module
#
# Copyright (c) 2021 Intel Corporation
#
# SPDX-License-Identifier: Apache-2.0
#

config POSTCODE_MANAGEMENT
	bool "Enable postcode management"
	default y
	help
	  Indicate if BIOS debug port 80 block is enabled and the values
	  are intercepted and display in 7-segment display array.

config POSTCODE_LOG_LEVEL
	int "Debug Port80 log level"
	depends on POSTCODE_MANAGEMENT
	depends on LOG
	default 2 if EC_DEBUG_LOG
	default 0
	help
	  Set log level for debug Port 80 log level.

config ESPI_PERIPHERAL_DEBUG_PORT_80
	default y if POSTCODE_MANAGEMENT
	default n

config DEBUG_LED
	bool "Enable generic debug support via keyboard leds"
	help
	  Repurpose keyboard LEDs to use as debug marker for timing
	  analysis. This prevents keyboard LEDs mirroring.
```

## app/dnx/Kconfig
```kconfig
# Kconfig - Config options for EC FW DnX support
#
# Copyright (c) 2021 Intel Corporation
#
# SPDX-License-Identifier: Apache-2.0
#
menu "EC DnX support"

config DNX_SUPPORT
	bool "Enable EC DnX support"
	default y
	help
	 Enables EC DnX awareness to handle DnX entry flows while disabling
	 EC timeout.

config DNX_LOG_LEVEL
	int "EC DnX module log level"
	depends on LOG
	default 2 if EC_DEBUG_LOG
	default 0
	help
	  Define log level for EC DnX module.

config DNX_SELF_RESET
	bool "Enable EC soft-reset in DnX flows"
	default y
	depends on DNX_SUPPORT
	help
	 Enables EC DnX reset as indicated in DnX flows, this is trigger if
	 global reset occurs while DnX warn is set.
endmenu

menu "EC-assisted DnX entry"

config DNX_EC_ASSISTED_TRIGGER
	bool "EC-assisted DnX trigger"
	help
	  Enable support in which EC will assist DnX entry by performing
	  handshake with Intel PCH to allow SoC to enter DnX mode.

choice
	prompt "Select EC-assisted DnX trigger method"
	default DNX_EC_ASSISTED_TRIGGER_SMC
	depends on DNX_EC_ASSISTED_TRIGGER
	help
	 Select method to notify EC about user desire to assist on DnX entry
	 in the platform for board designs where the DnX HW strap cannot be
	 set through a jumper.

	config DNX_EC_ASSISTED_TRIGGER_SMC
		bool "SMC command to initiate DnX"
		help
		  Allows to use BIOS-EC commands to indicate EC that needs to
		  set DnX strap and if supported trigger system restart.

	config DNX_EC_ASSISTED_TRIGGER_KEYBOARD
		depends on EARLY_KEY_SEQUENCE_DETECTION
		bool "Keyboard matrix hotkey to initiate DnX"
		help
		  Enable EC keyboard-based detection to detect user
		  pre-determined hotkey that would allow to enter Dnx mode.

endchoice

endmenu
```

## app/dtt/Kconfig
```kconfig
# Kconfig - Config options for EC FW DTT module
#
# Copyright (c) 2021 Intel Corporation
#
# SPDX-License-Identifier: Apache-2.0
#

menuconfig DTT_SUPPORT
	bool "DTT (Dynamic Thermal Tuning) framework support"
	default y
	help
	  Indicate if EC supports Intel Dynamic Thermal Tuning framework.

if DTT_SUPPORT

config DTT_SUPPORT_THERMALS
	bool "DTT support for thermal management"
	default y if THERMAL_MANAGEMENT
	help
	  Indicate if EC supports DTT thermal management.
	  DTT monitors thermal sensors, and needs trip notifications from
	  EC whenever threshold limits set by DTT are crossed.

config DTT_MODULE_LOG_LEVEL
	int "DTT power management log level"
	depends on DTT_SUPPORT
	depends on LOG
	default 2 if EC_DEBUG_LOG
	default 0
	help
	  Set log level for DTT module.

endif # DTT_SUPPORT
```

## app/kbchost/Kconfig
```kconfig
# Kconfig - Config options for keyboard module
#
# Copyright (c) 2021 Intel Corporation
#
# SPDX-License-Identifier: Apache-2.0

menu "Keyboard and mouse"

config PS2_KEYBOARD
	bool "Turn on PS/2 keyboard application application module."
	default y if ESPI_PERIPHERAL_8042_KBC && PS2
	help
	  It is desirable that users turn this feature on, only if there
	  is intention to use it.
	  PS/2 and keyboard scan matrix use the same application interfaces
	  to communicate information from/to the host.

config PS2_MOUSE
	bool "Turn on PS/2 mouse application application module."
	default y if ESPI_PERIPHERAL_8042_KBC && PS2
	help
	  It is desirable that users turn this feature on, only if there
	  is intention to use it.

config KSCAN_EC
	bool "Turn on kscan matrix application module."
	default y if ESPI_PERIPHERAL_8042_KBC && KSCAN
	help
	  The keyboard scan matrix is a passive device which do not send
	  any command during the configuration phase. Therefore, the EC has
	  to fake this commands in order to preseve host configuration flow.
	  PS/2 and keyboard scan matrix use the same application interfaces
	  to communicate information from/to the host.

config KBC_TASK_STACK_SIZE
	int "Adjust host keyboard management thread stack size"
	default 500 if SOC_IT8XXX2
	default 500 if SOC_FAMILY_MEC
	help
	 EC FW keyboard management thread task stack size.

config KB_TASK_STACK_SIZE
	int "Adjust keyboard matrix/PS2 devices management thread stack size"
	default 452 if SOC_IT8XXX2
	default 384 if SOC_FAMILY_MEC
	help
	 EC FW keyboard matrix/PS2 device management thread task stack size.

config KBCHOST_LOG_LEVEL
	int "kbchost log level"
	depends on LOG
	default 2 if EC_DEBUG_LOG
	default 0
	help
	  Set log level for the kbc8042 module and ps2.

endmenu
```

## app/peripheral_management/Kconfig
```kconfig
# Kconfig - Config options for EC FW peripheral management
#
# Copyright (c) 2021 Intel Corporation
#
# SPDX-License-Identifier: Apache-2.0
#

config PERIPHERAL_MANAGEMENT
	bool "Enable EC human interface"
	default y
	help
	  Enable EC support for button, switches, this includes:
	  1) Buttons: i.e power button
	  2) Switches: EC HW straps used to change EC behavior.

config PERIPHERAL_DEBOUNCE_TIME
	int "Switches/button debounce time"
	default 5
	depends on PERIPHERAL_MANAGEMENT
	help
	  Indicate time in milliseconds used to debounce buttons
	  and switches for user interaction.

config PERIPHERAL_LOG_LEVEL
	int "Peripheral log level"
	depends on PERIPHERAL_MANAGEMENT
	depends on LOG
	default 2 if EC_DEBUG_LOG
	default 0
	help
	  Set log level for peripheral module.
```

## app/power_management/Kconfig
```kconfig
# Kconfig - Config options for EC FW power management module
#
# Copyright (c) 2021 Intel Corporation
#
# SPDX-License-Identifier: Apache-2.0
#

menu "Power management"

config PWRMGMT
	bool "Enable EC power management"
	default y
	help
	  Indicate if EC supports power management this includes:
	  1) ACPI spec system transitions to S3, S4, S5
	  2) Intel-specific transitions to Sx sub-states during S3/S4/S5
	  (deep Sx) and or transition to S0ix during S0 (deep sleep)

config IDLE_STACK_SIZE
	default 512 if EC_DEBUG_LOG

config PWRMGMT_DEEPSX
	bool "Enable system deep suspend support"
	help
	  Indicate if EC supports deep suspend process. Deep suspend refers
	  to additional transition during S4, S5 states but reducing power
	  further since EC loses either context or power.

config PWRMGMT_DEEPSX_S3
	bool "Support deep suspend during S3 transition"
	depends on PWRMGMT_DEEPSX
	help
	  Indicate if deep suspend is supported in S3 transition in which case
	  EC loses power.

config PWRMGMT_PG3_EXIT_WAKE_FROM_SX
	bool "Enable additional wake from Sx after PG3 Exit"
	help
	  For PG3 enabled system, when system exits PG3 and lands in Sx state,
	  enabling this config option allows EC to trigger Sx wake.

config PWRMGMT_DEEPSX_LOG_LEVEL
	int "Power management deep sx log level"
	depends on PWRMGMT
	depends on LOG
	default 2 if EC_DEBUG_LOG
	default 0
	help
	  Set log level for power management module which includes Intel
	  transitions into deep sx sub-states.

endmenu
```

## app/power_sequencing/Kconfig
```kconfig
# Kconfig - Config options for EC FW power sequencing module
#
# Copyright (c) 2021 Intel Corporation
#
# SPDX-License-Identifier: Apache-2.0
#

menu "Power on/bring-up overrides"

config POWER_SEQUENCE_DISABLE_TIMEOUTS
	bool "Disable power sequence timeouts"
	help
	  Indicate if EC will enforce timeouts during power sequencing or not.

config POWER_SEQUENCE_MINIMUM_ESPI_CAPS
	bool "eSPI handshake with minimum capabilities"
	help
	  Configure eSPI bus to advertise the minimum capabilities required
	  to complete power sequence.

config POWER_SEQUENCE_ERROR_LED
	bool "Enable LED power sequencing error notification"
	help
	  Indicate if EC supports LED notifications for errors during power
	  sequencing.

config EC_DELAYED_BOOT
	int "Enable EC FW delayed boot"
	default 0
	help
	  Indicate if EC FW boot is delayed for N seconds. This is useful to
	  debug early app initialization via serial logs or JTAG.

config PWRMGT_LOG_LEVEL
	int "Power management log level"
	depends on PWRMGMT
	depends on LOG
	default 3 if EC_DEBUG_LOG
	default 0
	help
	  Set log level for power management module.
endmenu
```

## app/saf/Kconfig
```kconfig
# Kconfig - Config options for SAF module
#
# Copyright (c) 2021 Intel Corporation
#
# SPDX-License-Identifier: Apache-2.0

menu "Slave attached flash"
config SAF_SPI_DEVICES_COUNT
	int "Number of SPI devices in the SAF layout"
	default 1
	depends on ESPI_SAF
	help
	  Indicate number of SPI devices that constitutes the layout for
	  Intel Integrated Firmware in SAF boot configuration.

config SAF_SPI_CAPACITY
	int "SAF SPI flash capacity"
	default 16
	depends on ESPI_SAF
	help
	  Indicate SPI flash devices capacity in MB.

config SAF_SPI_FREQ_MHZ
	int "SAF SPI flash frequency"
	default 24
	depends on ESPI_SAF
	help
	  Indicate SPI flash devices frequency in MHz.

config SAF_ENABLE_XIP
	bool "Enable XIP when supported"
	depends on ESPI_SAF
	help
	  Indicate SPI flash has no continuous read enabled by default.

choice
	prompt "Select your SAF SPI flash device"
	default SAF_SPI_WINBOND
	depends on ESPI_SAF
	help
	 Select your SPI flash device vendor to allow to select correct
	 SPI-vendor specific command opcodes.

	config SAF_SPI_WINBOND
		bool "SAF Windbond SPI flash device"

endchoice

endmenu
```

## app/smchost/Kconfig
```kconfig
# Kconfig - Config options for SMC module
#
# Copyright (c) 2021 Intel Corporation
#
# SPDX-License-Identifier: Apache-2.0

menu "System management controller (SMC)"

config SMCHOST
	bool "Enable EC - BIOS interaction"
	default y
	help
	  Enables EC communication to BIOS.

config SMCHOST_SCI_OVER_ESPI
	bool "Enable SCI support over eSPI"
	default y
	help
	  Indicate if EC sends System Control Interrupt over eSPI bus
	  instead using a physical pin.

config SMCHOST_EVENT_DRIVEN_TASK
	bool "Enable SMCHOST event driven support"
	help
	  Indicate if EC sends System Control Interrupt will be event driven
	  instead of been a periodic task.

config DEPRECATED_SMCHOST_CMD
	bool "Support for deprecated host commands for backward compatibility"
	help
	  Some of the SMCHost commands are no longer used / to be supported in
	  BIOS & EC. Hence support for those removed with flag option.
	  Once BIOS is ready with support i.e. remove calling these deprecated
	  commands, then this flag and associated code can be removed
	  from EC as well.

config SMCHOST_LOG_LEVEL
	int "System management controller log level"
	depends on LOG
	default 2 if EC_DEBUG_LOG
	default 0
	help
	  Set log level for board system management controller host module
	  main interface.
endmenu
```

## app/soc_debug_awareness/Kconfig
```kconfig
# Kconfig - Config options for soc-debug awareness module
#
# Copyright (c) 2021 Intel Corporation
#
# SPDX-License-Identifier: Apache-2.0

menu "SoC debug awareness"

config SOC_DEBUG_AWARENESS
	bool "Enable methods to handle SoC debug consent in EC FW."
	default y
	help
	 Enable methods to handle SoC debug consent in EC FW.

config SOC_DEBUG_CONSENT_GPIO
	bool "Enable method where SoC debug consent"
	depends on SOC_DEBUG_AWARENESS
	help
	 Enable method where SoC debug consent is conveyed physically to EC via
	 GPIO. If not enabled EC timeout disable is handled statically.

config SOC_GPIO_VALID_AFTER_MS
	int "Soc Debug sample"
	default 500
	depends on SOC_DEBUG_CONSENT_GPIO
	help
	  SoC debug GPIO is valid after this amount of miliseconds.

config POWER_SEQUENCE_DISABLE_TIMEOUT_HOTKEY
	bool "Use key sequence to disable EC timeout"
	depends on EARLY_KEY_SEQUENCE_DETECTION
	depends on SOC_DEBUG_AWARENESS
	help
	  Intercept key sequence at boot to disable EC timeout. Useful for DnX
	  debug.

endmenu
```

## app/thermal_management/Kconfig
```kconfig
# Kconfig - Config options for EC FW
#
# Copyright (c) 2021 Intel Corporation
#
# SPDX-License-Identifier: Apache-2.0
#

menu "Thermal management"

config THERMAL_MANAGEMENT
	bool "Enable thermal management"
	help
	  Indicate if EC supports management of fan, reading thermal
	  sensors and cpu temperature.

config THERMAL_FAN_OVERRIDE
	bool "Enable fan override"
	help
	  Indicate if EC overrides fan control to pre-defined value. This
	  to ensure fan is running before Si parts are fully calibrated.

config THERMAL_FAN_OVERRIDE_VALUE
	int "Fan override duty cycle"
	default 70
	help
	  When EC overrides fan management via SW or HW strap, EC will
	  use this pre-defined duty cycle to control the fan.

config PECI_OVER_ESPI_ENABLE
	bool "Enable PECI over ESPI OOB"
	help
	  Indicate if peci over espi oob enabled or not.

config PECI_ACCESS_DISABLE_IN_CS
	bool "Disable PECI access in connected standby"
	help
	  Indicate if PECI access disabled in connected standby to achieve
	  infinite C10 residency.

config HW_STRAP_BASED_FAN_CONTROL
	bool "Enable HW STRAP based fan control"
	default y
	help
	  Enables HW Strap based fan control.

config THERMAL_MGMT_LOG_LEVEL
	int "Thermal management log level"
	depends on THERMAL_MANAGEMENT
	depends on LOG
	default 2 if EC_DEBUG_LOG
	default 0
	help
	  Set log level for thermal management module.

endmenu
```
