## out_of_tree_boards/boards/arm/mec1501_adl/Kconfig.board
```kconfig
# Copyright (c) 2020, Intel Corporation
# SPDX-License-Identifier: Apache-2.0

config BOARD_MEC1501_ADL
	bool "Intel MEC1501 ADL RVP board"
	depends on SOC_MEC1501_HSZ
```

## out_of_tree_boards/boards/arm/mec1501_adl_p/Kconfig.board
```kconfig
# Copyright (c) 2020, Intel Corporation
# SPDX-License-Identifier: Apache-2.0

config BOARD_MEC1501_ADL_P
	bool "Intel MEC1501 ADL-P RVP board"
	depends on SOC_MEC1501_HSZ
```

## out_of_tree_boards/boards/arm/mec1501_mtl_p/Kconfig.board
```kconfig
# Copyright (c) 2020, Intel Corporation
# SPDX-License-Identifier: Apache-2.0

config BOARD_MEC1501_MTL_P
	bool "Intel MEC1501 MTL-P RVP board"
	depends on SOC_MEC1501_HSZ
```

## out_of_tree_boards/boards/arm/mec1728_mtl_s/mec1728_mtl_s_defconfig
```kconfig
#
# Copyright (c) 2022, Intel Corporation
#
# SPDX-License-Identifier: Apache-2.0
#

CONFIG_SOC_MEC172X_NSZ=y
CONFIG_SOC_SERIES_MEC172X=y
CONFIG_BOARD_MEC1728_MTL_S=y
#CONFIG_BOARD_MEC172XMODULAR_ASSY6930=y
CONFIG_RTOS_TIMER=y

CONFIG_CLOCK_CONTROL=y
CONFIG_GPIO=y
CONFIG_PINCTRL=y
CONFIG_SERIAL=y
CONFIG_CONSOLE=y
CONFIG_UART_CONSOLE=y
CONFIG_PS2=y
CONFIG_ADC=y
CONFIG_PWM=y
CONFIG_SENSOR=y
CONFIG_PECI=y
CONFIG_I2C=y
CONFIG_KSCAN=n
CONFIG_KSCAN_XEC_DEBOUNCE_UP=1
CONFIG_KSCAN_XEC_DEBOUNCE_DOWN=1

CONFIG_ESPI=y
CONFIG_SPI=y
CONFIG_SPI_ASYNC=y
```

## out_of_tree_boards/boards/arm/mec172x_lj_mtl_template/Kconfig.board
```kconfig
# Copyright (c) 2023, Intel Corporation
# SPDX-License-Identifier: Apache-2.0

config BOARD_MEC172XLJ_MTL_TEMPLATE
	bool "MEC172X-LJ MTL template"
	depends on SOC_MEC172X_NLJ
```

## out_of_tree_boards/boards/arm/mec172x_mtl_s/Kconfig.board
```kconfig
# Copyright (c) 2022, Intel Corporation
# SPDX-License-Identifier: Apache-2.0

config BOARD_MEC172X_MTL_S
	bool "Intel MEC172X MTL S RVP board"
	depends on SOC_MEC172X_NSZ
```

## out_of_tree_boards/boards/arm/mec172x_mtl_s/mec172x_mtl_s_defconfig
```kconfig
#
# Copyright (c) 2022, Intel Corporation
#
# SPDX-License-Identifier: Apache-2.0
#

CONFIG_SOC_MEC172X_NSZ=y
CONFIG_SOC_SERIES_MEC172X=y
CONFIG_BOARD_MEC172X_MTL_S=y
CONFIG_RTOS_TIMER=y

CONFIG_CLOCK_CONTROL=y
CONFIG_GPIO=y
CONFIG_PINCTRL=y
CONFIG_SERIAL=y
CONFIG_CONSOLE=y
CONFIG_UART_CONSOLE=y
CONFIG_PS2=y
CONFIG_ADC=y
CONFIG_PWM=y
CONFIG_SENSOR=y
CONFIG_PECI=y
CONFIG_I2C=y

CONFIG_ESPI=y
CONFIG_SPI=y
CONFIG_SPI_ASYNC=y
```

## out_of_tree_boards/boards/arm/mec172x_ptl_uh/Kconfig.board
```kconfig
# Copyright (c) 2024, Intel Corporation
# SPDX-License-Identifier: Apache-2.0

config BOARD_MEC172X_PTL_UH
	bool "Intel MEC172X PTL UH RVP board"
	depends on SOC_MEC172X_NSZ
```

## out_of_tree_boards/boards/arm/npcx4m8f_ptl/Kconfig.board
```kconfig
# Copyright (c) 2024, Intel Corporation
# SPDX-License-Identifier: Apache-2.0

config BOARD_NPCX4M8F_PTL
	bool "Intel PTL RVP + Nuvoton NPCX4M8F EVB Development board"
	depends on SOC_NPCX4M8F
```

## out_of_tree_boards/boards/arm/npcx4m8f_ptl/Kconfig.defconfig
```kconfig
# Copyright (c) 2024, Intel Corporation
# SPDX-License-Identifier: Apache-2.0

if BOARD_NPCX4M8F_PTL

config BOARD
	default "npcx4m8f_ptl"

endif # BOARD_NPCX4M8F_PTL

config SYS_CLOCK_TICKS_PER_SEC
	default 1000

config INPUT
	default y if KSCAN
```

## out_of_tree_boards/boards/arm/npcx4m8f_ptl/npcx4m8f_ptl_defconfig
```kconfig
#
# Copyright (c) 2024, Intel Corporation
#
# SPDX-License-Identifier: Apache-2.0
#

CONFIG_SOC_NPCX4M8F=y
CONFIG_SOC_SERIES_NPCX4=y
CONFIG_BOARD_NPCX4M8F_PTL=y

# Enable NPCX bootloader firmware header
CONFIG_NPCX_HEADER=y
CONFIG_NPCX_IMAGE_OUTPUT_HEX=y
CONFIG_NPCX_HEADER_SPI_MAX_CLOCK_50=y
CONFIG_NPCX_HEADER_SPI_READ_MODE_DUAL=y

# Enable MPU
CONFIG_ARM_MPU=y

# Clock configuration
CONFIG_CLOCK_CONTROL=y

# General Kernel Options
CONFIG_SYS_CLOCK_HW_CYCLES_PER_SEC=15000000

# UART Driver
CONFIG_SERIAL=y
CONFIG_UART_INTERRUPT_DRIVEN=y

# GPIO Driver
CONFIG_GPIO=y

# Pin Controller Driver
CONFIG_PINCTRL=y

# Console Driver
CONFIG_CONSOLE=y
CONFIG_UART_CONSOLE=y
CONFIG_I2C=y
CONFIG_PWM=y
CONFIG_SENSOR=y
CONFIG_ADC=y
CONFIG_PECI=y
CONFIG_GPIO_PCA95XX=y
CONFIG_GPIO_PCA95XX_INTERRUPT=y

CONFIG_ESPI=y
CONFIG_ESPI_OOB_CHANNEL_RX_ASYNC=y
CONFIG_ESPI_NPCX_PERIPHERAL_DEBUG_PORT_80_MULTI_BYTE=y
CONFIG_ESPI_PERIPHERAL_UART=y
CONFIG_ESPI_PERIPHERAL_8042_KBC=y
CONFIG_ESPI_FLASH_CHANNEL=y
CONFIG_ESPI_PERIPHERAL_HOST_IO_PVT=y

CONFIG_ESPI_SAF=y
CONFIG_FLASH=y
CONFIG_ESPI_TAF_PR_NUM=16
CONFIG_ESPI_TAF_AUTO_MODE=y

CONFIG_PS2=y
```

## out_of_tree_boards/boards/microchip/mtl_s/Kconfig.defconfig
```kconfig
# Copyright (c) 2021 Microchip Technology Inc.
# SPDX-License-Identifier: Apache-2.0


config TACH_XEC
	default y
	depends on SENSOR
```

## out_of_tree_boards/boards/microchip/mtl_s/Kconfig.mtl_s
```kconfig
# Copyright (c) 2022, Intel Corporation
# SPDX-License-Identifier: Apache-2.0

config BOARD_MTL_S
	select SOC_MEC172X_NSZ
```

## out_of_tree_boards/boards/microchip/mtl_s/board.yml
```yaml
board:
  name: mtl_s
  full_name: MEC172X MTLS
  vendor: intel
  socs:
    - name: mec172x_nsz
```

## out_of_tree_boards/boards/microchip/ptl_uh/Kconfig.defconfig
```kconfig
# Copyright (c) 2024 Microchip Technology Inc.
# SPDX-License-Identifier: Apache-2.0


config TACH_XEC
	default y
	depends on SENSOR
```

## out_of_tree_boards/boards/microchip/ptl_uh/Kconfig.ptl_uh
```kconfig
# Copyright (c) 2022, Intel Corporation
# SPDX-License-Identifier: Apache-2.0

config BOARD_PTL_UH
	select SOC_MEC172X_NSZ
```

## out_of_tree_boards/boards/microchip/ptl_uh/board.yml
```yaml
board:
  name: ptl_uh
  full_name: MEC172X PTL_UH
  vendor: intel
  socs:
    - name: mec172x_nsz
```
