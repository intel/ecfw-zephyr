## out_of_tree_boards/boards/arm/mec172x_mtl_s/board.yml
```yaml
boards:
  - name: mec172x_mtl_s
    vendor: intel
    socs:
      - name: mec172x_nsz
```

## out_of_tree_boards/boards/arm/mec172x_ptl_uh/board.yml
```yaml
boards:
  - name: mec172x_ptl_uh
    vendor: intel
    socs:
      - name: mec172x_nsz
```

## out_of_tree_boards/boards/arm/mec172x_ptl_uh/mec172x_ptl_uh_defconfig
```kconfig
#
# Copyright (c) 2024, Intel Corporation
#
# SPDX-License-Identifier: Apache-2.0
#

CONFIG_RTOS_TIMER=y

CONFIG_CLOCK_CONTROL=y
CONFIG_GPIO=y
CONFIG_PINCTRL=y
CONFIG_SERIAL=y
CONFIG_CONSOLE=y
CONFIG_UART_CONSOLE=y
CONFIG_PS2=y
CONFIG_ADC=y
CONFIG_PWM=y
CONFIG_SENSOR=y
CONFIG_PECI=y
CONFIG_I2C=y
# Use Input driver with KSCAN interface
CONFIG_KSCAN=y
CONFIG_INPUT=y
CONFIG_LED=y

CONFIG_ESPI=y
CONFIG_ESPI_TAF=y
CONFIG_SPI=y
CONFIG_SPI_ASYNC=y
```

## out_of_tree_boards/boards/arm/npcx4m8f_ptl/Kconfig.npcx4m8f_ptl
```kconfig
# Copyright (c) 2024, Intel Corporation
# SPDX-License-Identifier: Apache-2.0

config BOARD_NPCX4M8F_PTL
	select SOC_NPCX4M8F
```

## out_of_tree_boards/boards/arm/npcx4m8f_ptl/board.yml
```yaml
boards:
  - name: npcx4m8f_ptl
    vendor: intel
    socs:
      - name: npcx4m8f
```
